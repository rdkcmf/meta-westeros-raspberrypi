## conf/layer.conf
```bitbake
BBPATH .= ":${LAYERDIR}"

BBFILES += "\
            ${LAYERDIR}/recipes-*/*/*.bb \
            ${LAYERDIR}/recipes-*/*/*.bbappend \
           "

BBFILE_COLLECTIONS += "westeros-raspberrypi"
BBFILE_PATTERN_westeros-raspberrypi := "^${LAYERDIR}/"
#BBFILE_PRIORITY_westeros-raspberrypi = "25"

LAYERDEPENDS_westeros-raspberrypi = "metrological"

require conf/include/externalsrc.inc
require conf/include/bbmask.inc
```
